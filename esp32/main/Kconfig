## esp32/main/Kconfig
```kconfig
# Language documentation: https://docs.espressif.com/projects/esp-idf-kconfig/en/latest/kconfiglib/language.html

menu "HASS Environment Sensor"
    config HASS_ENVIRONMENT_SENSOR_OTA_MANUFACTURER
        hex "OTA manufacturer ID"
        default 0x0
        help
            A unique ID that identifies you as manufacturer.
        range 0x0 0xFFFF

    config HASS_ENVIRONMENT_SENSOR_VERSION_MAJOR
        int "Major version number"
        default 1
        range 0 255

    config HASS_ENVIRONMENT_SENSOR_VERSION_MINOR
        int "Minor version number"
        default 0
        range 0 4095

    config HASS_ENVIRONMENT_SENSOR_VERSION_PATCH
        int "Patch version number"
        default 0
        range 0 4095

    choice HASS_ENVIRONMENT_SENSOR_DEVICE_TARGET
        prompt "The target device you want to build for"

        config HASS_ENVIRONMENT_SENSOR_DEVICE_TARGET_SEED_STUDIO_XIAO_ESPC6
            bool "seed studio XIAO ESPC6"
            default y
            help
                Compile the application for the seed studio XIAO ESPC6.
                Docs: https://wiki.seeedstudio.com/xiao_esp32c6_getting_started/
        
        config HASS_ENVIRONMENT_SENSOR_DEVICE_TARGET_ESP32_H2_DEV_KIT
            bool "Official ESP32 H2 Dev Kit"
            default n
            help
                Compile the application for the official ESP32 H2 developer kit.
                Docs: https://docs.espressif.com/projects/esp-dev-kits/en/latest/esp32h2/index.html
        
        config HASS_ENVIRONMENT_SENSOR_DEVICE_TARGET_ESP32_C6_DEV_KIT
            bool "Official ESP32 C6 Dev Kit"
            default n
            help
                Compile the application for the official ESP32 C6 developer kit.
                Docs: https://docs.espressif.com/projects/esp-dev-kits/en/latest/esp32c6/index.html
    endchoice

    config HASS_ENVIRONMENT_SENSOR_SCD41_MOCK
        bool "Enable the mock SCD41 sensor instead of the real one"
        default n
        help
            Useful in case you do not have a real one connected to the device.
endmenu
```

## esp32_h2/main/Kconfig
```kconfig
menu "HASS Environment Sensor"
    config HASS_ENVIRONMENT_SENSOR_OTA_MANUFACTURER
        hex "OTA manufacturer ID"
        default 0x0
        help
            A unique ID that identifies you as manufacturer.
        range 0x0 0xFFFF

    config HASS_ENVIRONMENT_SENSOR_VERSION_MAJOR
        int "Major version number"
        default 1
        range 0 255

    config HASS_ENVIRONMENT_SENSOR_VERSION_MINOR
        int "Minor version number"
        default 0
        range 0 4095

    config HASS_ENVIRONMENT_SENSOR_VERSION_PATCH
        int "Patch version number"
        default 0
        range 0 4095
endmenu
```
