## firmware/esp32/main/Kconfig
```kconfig
# Language documentation: https://docs.espressif.com/projects/esp-idf-kconfig/en/latest/kconfiglib/language.html

menu "HASS Environment Sensor"
    config HASS_ENVIRONMENT_SENSOR_OTA_MANUFACTURER
        hex "OTA manufacturer ID"
        default 0x0
        help
            A unique ID that identifies you as manufacturer.
        range 0x0 0xFFFF

    config HASS_ENVIRONMENT_SENSOR_VERSION_MAJOR
        int "Major version number"
        default 1
        range 0 255

    config HASS_ENVIRONMENT_SENSOR_VERSION_MINOR
        int "Minor version number"
        default 0
        range 0 4095

    config HASS_ENVIRONMENT_SENSOR_VERSION_PATCH
        int "Patch version number"
        default 0
        range 0 4095

    choice HASS_ENVIRONMENT_SENSOR_DEVICE_TARGET
        prompt "The target device you want to build for"
        default HASS_ENVIRONMENT_SENSOR_DEVICE_TARGET_SEED_STUDIO_XIAO_ESPC6

        config HASS_ENVIRONMENT_SENSOR_DEVICE_TARGET_SEED_STUDIO_XIAO_ESPC6
            bool "seed studio XIAO ESPC6"
            help
                Compile the application for the seed studio XIAO ESPC6.
                Docs: https://wiki.seeedstudio.com/xiao_esp32c6_getting_started/
        
        config HASS_ENVIRONMENT_SENSOR_DEVICE_TARGET_ESP32_H2_DEV_KIT
            bool "Official ESP32 H2 Dev Kit"
            help
                Compile the application for the official ESP32 H2 developer kit.
                Docs: https://docs.espressif.com/projects/esp-dev-kits/en/latest/esp32h2/index.html
        
        config HASS_ENVIRONMENT_SENSOR_DEVICE_TARGET_ESP32_C6_DEV_KIT
            bool "Official ESP32 C6 Dev Kit"
            help
                Compile the application for the official ESP32 C6 developer kit.
                Docs: https://docs.espressif.com/projects/esp-dev-kits/en/latest/esp32c6/index.html
    endchoice

    choice HASS_ENVIRONMENT_SENSOR_SCD41_MODE
        prompt "SCD41 sensor mode"
        default HASS_ENVIRONMENT_SENSOR_SCD41_DISABLED
        help
            Select disabled for boards without an SCD41. All Zigbee clusters remain present.

        config HASS_ENVIRONMENT_SENSOR_SCD41_DISABLED
            bool "Disabled (no sensor fitted)"
        config HASS_ENVIRONMENT_SENSOR_SCD41_REAL
            bool "Real SCD41"
        config HASS_ENVIRONMENT_SENSOR_SCD41_MOCK
            bool "Mock SCD41 (testing only)"
    endchoice

    config HASS_ENVIRONMENT_SENSOR_BME690_MOCK
        bool "Enable the mock BME690 sensor instead of the real one"
        default n
        help
            Useful in case you do not have a real one connected to the device.

    config HASS_ENVIRONMENT_SENSOR_PM_DIAGNOSTICS
        bool "Print power-management lock and sleep diagnostics"
        default n
        help
            Dumps ESP-IDF power-management locks after Zigbee initialization and after each
            scheduled idle interval. Also enable CONFIG_PM_PROFILING to report light-sleep
            residency and lock-held time. Enable only for debugging; a connected USB console
            affects power measurements.

    choice HASS_ENVIRONMENT_SENSOR_SLEEP_MODE
        prompt "ESP sleep mode between measurement cycles"
        default HASS_ENVIRONMENT_SENSOR_SLEEP_MODE_LIGHT_SLEEP
        help
            Select how the firmware idles between scheduled measurements.

        config HASS_ENVIRONMENT_SENSOR_SLEEP_MODE_LIGHT_SLEEP
            bool "Light sleep"
            help
                Keep the Zigbee sleepy end device joined to the network and let the
                ESP/Zigbee stack enter light sleep between measurement cycles.
                This allows Home Assistant commands such as Identify to reach the
                device while it is idle.

        config HASS_ENVIRONMENT_SENSOR_SLEEP_MODE_DEEP_SLEEP
            bool "Deep sleep"
            help
                Shut the SoC down completely between measurement cycles and reboot on
                every wake-up. This minimizes idle power, but the device cannot receive
                Zigbee commands while asleep.
    endchoice
endmenu
```
